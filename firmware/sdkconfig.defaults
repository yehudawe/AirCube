## firmware/sdkconfig.defaults
```kconfig
#
# AirCube default build configuration
#

#
# Flash size (AirCube hardware has 2MB flash)
#
CONFIG_ESPTOOLPY_FLASHSIZE_2MB=y
CONFIG_ESPTOOLPY_FLASHSIZE="2MB"

#
# Custom partition table (includes zb_storage, zb_fct, and history partitions)
#
CONFIG_PARTITION_TABLE_CUSTOM=y
CONFIG_PARTITION_TABLE_CUSTOM_FILENAME="partitions_zigbee.csv"
CONFIG_PARTITION_TABLE_FILENAME="partitions_zigbee.csv"

#
# Zigbee (required by firmware/main/zigbee.c)
#
CONFIG_ZB_ENABLED=y
# CONFIG_ZB_ZCZR is not set
CONFIG_ZB_ZED=y
# CONFIG_ZB_ZGPD is not set
CONFIG_ZB_RADIO_NATIVE=y
# CONFIG_ZB_RADIO_SPINEL_UART is not set
CONFIG_AIRCUBE_ZB_TX_POWER_DBM=20

#
# Bluetooth disabled for DIY SuperMini builds (avoids NimBLE build issues;
# USB serial + Zigbee still work). Re-enable for official AirCube hardware.
#
# CONFIG_BT_ENABLED is not set

#
# Radio coexistence — only needed when both Zigbee and BLE are active.
#
# CONFIG_ESP_COEX_SW_COEXIST_ENABLE is not set
```
